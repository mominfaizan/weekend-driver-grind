/dts-v1/;

/ {
    compatible = "demo,test-board";
	#address-cells = <1>;
    #size-cells = <1>;

    demo@20000 {
        compatible = "demo,platform";
        status = "okay";
	reg = <0x20000 0x1000>;   
	};
};
